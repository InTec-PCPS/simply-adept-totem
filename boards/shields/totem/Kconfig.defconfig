## boards/shields/totem/Kconfig.defconfig
```kconfig
if SHIELD_TOTEM_LEFT || SHIELD_TOTEM_RIGHT || SHIELD_TOTEM_DONGLE || SHIELD_TOTEM_TRACKBALL
config ZMK_SPLIT
    default y
config ZMK_POINTING
    default y
endif

if SHIELD_TOTEM_DONGLE
config ZMK_KEYBOARD_NAME
    default "Totem"
config ZMK_SPLIT_ROLE_CENTRAL
    default y
# Set this to the number of peripherals your dongle will have.
# For a unibody, this would be 1. If you have left and right halves, set it to 2, etc.
config ZMK_SPLIT_BLE_CENTRAL_PERIPHERALS
    default 3
endif

if SHIELD_TOTEM_TRACKBALL
config SPI
    default y
endif
```
